#include "charybdis.dtsi"
#include "charybdis_pmw3610.dtsi"

/ {
    // The physical layout is already defined in charybdis.dtsi
    // via charybdis-layouts.dtsi

    chosen {
        // Dongle essentials
        zmk,usb = &usbd;
        zmk,bluetooth = &bt;

        // Keep physical layout reference
        zmk,physical-layout = &charybdis_physical_layout;

        // Don't set kscan or matrix-transform for dongle
        // zmk,kscan = &kscan0;  // Comment out or remove
        // zmk,matrix-transform = &default_transform;  // Comment out or remove
    };
};

&trackball {
    status = "okay";
};

// If needed, ensure the kscan is disabled for dongle
&kscan0 {
    status = "disabled";
};
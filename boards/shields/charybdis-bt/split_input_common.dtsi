#include <dt-bindings/zmk/input_transform.h>
#include <input/processors.dtsi>

#define Base 0
#define Nav 1
#define Num 2
#define Scroll 3

// Enable the trackball
&trackball {
    status = "okay";
};

/ {
  split_inputs {
    #address-cells = <1>;
    #size-cells = <0>;

    trackball_split: trackball_split@0 {
      compatible = "zmk,input-split";
      reg = <0>;
    };
  };

  trackball_listener: trackball_listener {
    compatible = "zmk,input-listener";
    device = <&trackball>;

    scroll {
      layers = <Scroll>;
      input-processors = <&zip_xy_transform (INPUT_TRANSFORM_Y_INVERT)>, <&zip_xy_scaler 1 12>, <&zip_xy_to_scroll_mapper>;
    };
  };
};

// / {
//     chosen { zmk,matrix_transform = &default_transform; };
// };

/ {
    /* input config for mouse move mode */

    trackball_listener {
        compatible = "zmk,input-behavior-listener";
        device = <&vtrackball>;
        layers = <0 1 2>;
        evt-type = <INPUT_EV_REL>;
        x-input-code = <INPUT_REL_X>;
        y-input-code = <INPUT_REL_Y>;
        scale-multiplier = <1>;
        scale-divisor = <2>;

        // bindings = <&ib_toggle_layer 7>;
    };

    /* input config for snipe mode */

    trackball_snipe_listener {
        compatible = "zmk,input-behavior-listener";
        device = <&vtrackball>;
        layers = <4>;
        evt-type = <INPUT_EV_REL>;
        x-input-code = <INPUT_REL_X>;
        y-input-code = <INPUT_REL_Y>;
        scale-multiplier = <1>;
        scale-divisor = <4>;
    };

    /* input config for mouse scroll mode */

    trackball_scroll_listener {
        compatible = "zmk,input-behavior-listener";
        device = <&vtrackball>;
        layers = <3>;
        evt-type = <INPUT_EV_REL>;
        x-input-code = <INPUT_REL_HWHEEL>;
        y-input-code = <INPUT_REL_WHEEL>;
        bindings = <&ib_hwheel_scaler 1 14 &ib_wheel_scaler 1 14>;
    };

    /* define a resolution down scaler only for INPUT_REL_WHEEL */

    ib_wheel_scaler: ib_wheel_scaler {
        compatible = "zmk,input-behavior-scaler";
        #binding-cells = <2>;
        evt-type = <INPUT_EV_REL>;
        input-code = <INPUT_REL_WHEEL>;
    };

    ib_hwheel_scaler: ib_hwheel_scaler {
        compatible = "zmk,input-behavior-scaler";
        #binding-cells = <2>;
        evt-type = <INPUT_EV_REL>;
        input-code = <INPUT_REL_HWHEEL>;  // Different input code
    };

    /* adjust cooldown waiting period for mouse key layer after activated */

    ib_toggle_layer: ib_toggle_layer {
        compatible = "zmk,input-behavior-tog-layer";
        #binding-cells = <1>;
        time-to-live-ms = <750>;
    };